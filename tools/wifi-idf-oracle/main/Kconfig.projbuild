## tools/wifi-idf-oracle/main/Kconfig.projbuild
```kconfig
menu "Oracle Wi-Fi credentials"

    config ORACLE_WIFI_SSID
        string "SSID to join"
        default ""

    config ORACLE_WIFI_PASSWORD
        string "Passphrase"
        default ""

    config ORACLE_REGDUMP
        bool "Dump documented registers after esp_wifi_init / esp_wifi_start (for comparing with the s31-firmware probe)"
        default n

endmenu
```
